## src/Kconfig
```kconfig
menu "Core"
  config CORE_DEFAULT_LOG_LEVEL
    int
    range 0 2
    default 1
    prompt "Set the default log level. 0 (ERROR) to 2 (DEBUG)"

  config CORE_DEFAULT_PLUGINS_DIRECTORY
    string
    default "./build/modules"
    prompt "Set the default plugins directory"

  config DEFAULT_CONFIGFILE
    string
    default "lxcmanager.json"
    prompt "Set the default configuration file"

endmenu
```

## src/plugins/Kconfig
```kconfig
menu "Plugins"
  config PLUGIN_COMMUNICATION
    bool
    default y
    prompt "Compile the communication plugin"
    help
      Compile the communication plugin

  config PLUGIN_EMPTY
    bool
    default n
    prompt "Compile the empty (for test only)"
endmenu
```
